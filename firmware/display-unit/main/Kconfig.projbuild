## firmware/display-unit/main/Kconfig.projbuild
```kconfig
menu "Display unit"

config DASH_DEV_DEMO_BUTTON
    bool "Always-visible DEMO button (development)"
    default y
    help
        Shows a small DEMO button in the bottom-left corner on every screen that opens
        the demo scene picker without the parent PIN. Turn off for the car.

config DASH_LOG_FPS
    bool "Log rendered frames per second"
    default y
    help
        Prints the number of LVGL refreshes per second to the console.

config DASH_LVGL_CORE1
    bool "Pin the LVGL task to core 1"
    default y
    help
        The RGB panel's bounce-buffer copy runs as an ISR on core 0 (about a third of that core).
        Pinning the LVGL task to core 1 keeps rendering off it: measured 5-7 % less draw time per frame.

config DASH_PCLK_MHZ
    int "RGB panel pixel clock, MHz"
    range 16 40
    default 21
    help
        The panel refreshes at pclk / (1369 * 637) Hz: 21 MHz gives 24 Hz, 26 MHz about 30 Hz. LVGL
        is synchronised to the refresh, so this is the frame-rate ceiling (rendering takes 1-15 ms per
        frame, far less than the 41 ms of one refresh). Tested on the 5B panel: 26 MHz already flickers and shows
        artifacts (PSRAM bandwidth for the bounce buffer refill). Keep 21.

config DASH_RGB_BOUNCE
    bool "Use the RGB panel bounce buffer (keep on)"
    default y
    help
        With the bounce buffer the panel is fed from a small internal-RAM buffer that an ISR on core 0
        refills from the PSRAM frame buffers (about a third of core 0, ~14 ms per frame). Turning it off
        lets the panel DMA read PSRAM directly and frees that core time, but while the CPU renders into
        PSRAM the picture can flicker, shift sideways or tear. Tested on the 5B panel: without it the picture
        flickers and shifts sideways constantly. Keep it on.

config DASH_DEMO_THEME_CYCLE
    bool "Autodemo cycles the gauge themes (profiling aid)"
    default n
    help
        While the autodemo runs, switch to the next gauge theme every 10 s. Lets the frame profiler
        cover all four themes without touching the panel.

endmenu
```

## firmware/display-unit/sdkconfig.defaults
```kconfig
CONFIG_IDF_TARGET="esp32s3"
CONFIG_ESPTOOLPY_FLASHSIZE_16MB=y
CONFIG_ESPTOOLPY_FLASHMODE_QIO=y
CONFIG_ESPTOOLPY_FLASHFREQ_80M=y
CONFIG_PARTITION_TABLE_CUSTOM=y
CONFIG_PARTITION_TABLE_CUSTOM_FILENAME="partitions.csv"
CONFIG_COMPILER_OPTIMIZATION_PERF=y

CONFIG_FREERTOS_HZ=1000
CONFIG_ESP_DEFAULT_CPU_FREQ_MHZ_240=y
CONFIG_ESP32S3_INSTRUCTION_CACHE_32KB=y
CONFIG_ESP32S3_DATA_CACHE_64KB=y
CONFIG_ESP32S3_DATA_CACHE_LINE_64B=y

# Octal PSRAM; run code/rodata from PSRAM so flash writes (NVS) do not stall the RGB panel
CONFIG_SPIRAM=y
CONFIG_SPIRAM_MODE_OCT=y
CONFIG_SPIRAM_SPEED_80M=y
CONFIG_SPIRAM_XIP_FROM_PSRAM=y
CONFIG_SPIRAM_MEMTEST=n
CONFIG_LCD_RGB_ISR_IRAM_SAFE=y

# LVGL 9
CONFIG_LV_OS_FREERTOS=y
CONFIG_LV_USE_CLIB_MALLOC=y
CONFIG_LV_USE_CLIB_STRING=y
CONFIG_LV_USE_CLIB_SPRINTF=y
CONFIG_LV_DEF_REFR_PERIOD=15
CONFIG_LV_OBJ_STYLE_CACHE=y
CONFIG_LV_DRAW_SW_DRAW_UNIT_CNT=2
CONFIG_LV_COLOR_DEPTH_16=y
CONFIG_LV_FONT_MONTSERRAT_14=y
CONFIG_LV_USE_FLOAT=y
CONFIG_LV_USE_SYSMON=y
CONFIG_LV_USE_PERF_MONITOR=n
CONFIG_LV_USE_LOG=y
CONFIG_LV_LOG_LEVEL_WARN=y
CONFIG_LV_LOG_PRINTF=y
CONFIG_LV_USE_DEMO_WIDGETS=n

# drive page bakes its static dial art into a bitmap (lv_snapshot)
CONFIG_LV_USE_SNAPSHOT=y
```

## firmware/remote-gateway/components/elrs/Kconfig
```kconfig
menu "Remote Gateway ELRS"

    config ELRS_RX_GPIO
        int "UART1 RX GPIO (connect receiver TX here)"
        range 0 48
        default 16
        help
            Select a free input-capable GPIO exposed on your development board.
            GPIO16 is the initial wiring choice for the ESP32-S3 dev kit.

    config ELRS_SIGNAL_TIMEOUT_MS
        int "RC channel freshness timeout (ms)"
        range 50 1000
        default 200
        help
            Only CRC-checked, range-checked RC channel frames refresh this timer.

endmenu
```

## firmware/remote-gateway/components/pwm_rc/Kconfig
```kconfig
menu "Remote Gateway PWM RC"

    config PWM_RC_CH1_GPIO
        int "CH1 steering capture GPIO"
        range 0 48
        default 5

    config PWM_RC_CH2_GPIO
        int "CH2 throttle capture GPIO"
        range 0 48
        default 6

    config PWM_RC_CH3_GPIO
        int "CH3 mode button capture GPIO"
        range 0 48
        default 7

    config PWM_RC_TIMEOUT_MS
        int "PWM channel freshness timeout (ms)"
        range 50 500
        default 100

    config PWM_RC_MIN_US
        int "Calibration minimum pulse (us)"
        range 800 2200
        default 1000

    config PWM_RC_CENTER_US
        int "Calibration center pulse (us)"
        range 800 2200
        default 1500

    config PWM_RC_MAX_US
        int "Calibration maximum pulse (us)"
        range 800 2200
        default 2000

    config PWM_RC_DEADBAND_US
        int "Steering and throttle neutral deadband (+/-us)"
        range 0 100
        default 20

    config PWM_RC_THROTTLE_MIN_US
        int "CH2 throttle calibration minimum pulse (us)"
        range 800 2200
        default PWM_RC_MIN_US
        help
            Measured CH2 low endpoint, mapped to -1000 before inversion.
            Overrides the common minimum for the throttle channel only.

    config PWM_RC_THROTTLE_CENTER_US
        int "CH2 throttle calibration neutral pulse (us)"
        range 800 2200
        default PWM_RC_CENTER_US
        help
            Measured CH2 neutral pulse. The common deadband applies here.

    config PWM_RC_THROTTLE_MAX_US
        int "CH2 throttle calibration maximum pulse (us)"
        range 800 2200
        default PWM_RC_MAX_US
        help
            Measured CH2 high endpoint, mapped to +1000 before inversion.
            Overrides the common maximum for the throttle channel only.

    config PWM_RC_STEERING_INVERTED
        bool "Invert PWM steering"
        default n

    config PWM_RC_THROTTLE_INVERTED
        bool "Invert PWM throttle"
        default n

endmenu
```

## firmware/remote-gateway/components/remote_uart/Kconfig
```kconfig
menu "Remote Gateway UART"

    config REMOTE_UART_TX_GPIO
        int "UART2 TX GPIO (connect to Vehicle ECU RX)"
        range 0 48
        default 4

endmenu
```

## firmware/remote-gateway/sdkconfig.defaults
```kconfig
CONFIG_IDF_TARGET="esp32s3"
CONFIG_ESPTOOLPY_FLASHSIZE_16MB=y
CONFIG_REMOTE_UART_TX_GPIO=4
CONFIG_PWM_RC_THROTTLE_MAX_US=1980
```
